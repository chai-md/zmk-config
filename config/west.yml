## config/west.yml
```yaml
manifest:
  remotes:
    - name: chai-md
      url-base: https://github.com/chai-md
  projects:
    - name: zmk
      remote: chai-md
      revision: main
      import: app/west.yml
  self:
    path: config
```
